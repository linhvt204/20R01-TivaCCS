// These arguments were used when this file was generated. They will be automatically applied on subsequent loads 
// via the GUI or CLI invocations. Run CLI with '--help' for additional information on how to override these arguments.
// @cliArgs --device "TM4C123x" --package "64 Pin QFP|16x16" --part "TM4C123GH6PM"
// @versions {"data":"2019083011","timestamp":"2019083011","tool":"1.2.952","templates":"2019083011"}

var iComparator1 = scripting.addPeripheral("Comparator");
// Name
iComparator1.$name = "MyComparator0";
// Use Peripheral
iComparator1.$assign = "Comparator0";
// Used
iComparator1.O.$used = false;
// Used
iComparator1["+"].$used = false;
// Suggest solution
iComparator1["-"].$suggestSolution = "13";
