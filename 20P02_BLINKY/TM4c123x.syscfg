// These arguments were used when this file was generated. They will be automatically applied on subsequent loads 
// via the GUI or CLI invocations. Run CLI with '--help' for additional information on how to override these arguments.
// @cliArgs --device "TM4C123x" --package "64 Pin QFP|16x16" --part "TM4C123GH6PM"
// @versions {"data":"2019083011","timestamp":"2019083011","tool":"1.2.952","templates":"2019083011"}

var iGPIO1 = scripting.addPeripheral("GPIO");
// Assign pin
iGPIO1["0"].$assign = "PF0"; // pin number - 28
// Name
iGPIO1.$name = "MyGPIO4";
var iGPIO2 = scripting.addPeripheral("GPIO");
// PU/PD
iGPIO2["0"].pu_pd = "pu";
// Assign pin
iGPIO2["0"].$assign = "PF4"; // pin number - 5
// Name
iGPIO2.$name = "MyGPIO5";
