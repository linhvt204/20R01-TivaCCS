// These arguments were used when this file was generated. They will be automatically applied on subsequent loads 
// via the GUI or CLI invocations. Run CLI with '--help' for additional information on how to override these arguments.
// @cliArgs --device "TM4C123x" --package "64 Pin QFP|16x16" --part "TM4C123GH6PM"
// @versions {"data":"2019083011","timestamp":"2019083011","tool":"1.2.952","templates":"2019083011"}

var iADC1 = scripting.addPeripheral("ADC");
// Name
iADC1.$name = "MyADC0";
// Use Peripheral
iADC1.$assign = "ADC0";
// Used
iADC1.AIN0.$used = false;
// Used
iADC1.AIN9.$used = false;
// Used
iADC1.AIN4.$used = false;
// Used
iADC1.AIN8.$used = false;
// Used
iADC1.AIN6.$used = false;
// Used
iADC1.AIN2.$used = false;
// Used
iADC1.AIN3.$used = false;
// Used
iADC1.AIN11.$used = false;
// Used
iADC1.AIN10.$used = false;
// Used
iADC1.AIN7.$used = false;
// Used
iADC1.AIN5.$used = false;
// Suggest solution
iADC1.AIN1.$suggestSolution = "7";
