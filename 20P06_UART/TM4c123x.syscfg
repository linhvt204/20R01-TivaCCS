// These arguments were used when this file was generated. They will be automatically applied on subsequent loads 
// via the GUI or CLI invocations. Run CLI with '--help' for additional information on how to override these arguments.
// @cliArgs --device "TM4C123x" --package "64 Pin QFP|16x16" --part "TM4C123GH6PM"
// @versions {"data":"2019083011","timestamp":"2019083011","tool":"1.2.952","templates":"2019083011"}

var iUART1 = scripting.addPeripheral("UART");
// Name
iUART1.$name = "MyUART0";
// Use Peripheral
iUART1.$assign = "UART1";
// Used
iUART1.RTS.$used = false;
// Used
iUART1.CTS.$used = false;
// Suggest solution
iUART1.RX.$suggestSolution = "45";
// Suggest solution
iUART1.TX.$suggestSolution = "46";
